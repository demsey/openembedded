## conf/distro/openstmstb.conf
```bitbake
#@TYPE: Distribution
#@NAME: Open-STM-STB
#@DESCRIPTION: Distribution configuration for Open-STM-STB

INHERIT += "package_ipk debian"
INHERIT += "packaged-staging"

SYSVINIT_ENABLED_GETTYS = ""
DISTRO = "openstmstb"
DISTRO_NAME = "Open-STM-STB"
DISTRO_VERSION = "0.0.5"
DISTRO_PR ?= ""

# for image.bbclass:
IMAGE_DEV_MANAGER ?= "udev"
IMAGE_INIT_MANAGER ?= "sysvinit"
IMAGE_INITSCRIPTS ?= "initscripts-opendreambox"
IMAGE_LOGIN_MANAGER ?= ""
IMAGE_FSTYPES ?= "tar.bz2 jffs2"

# for rootfs_ipk.bbclass:
IPKG_VARIANT = "opkg-nogpg"

# for dreambox-feed-configs:
DISTRO_FEED_URI = "http://sources.dreamboxupdate.com/${DISTRO}/1.6/experimental"

SRCDATE = 20070625

STM_RELEASE ?= "stm23"
SRCREV_pn-linux-${MACHINE} ?= "0123"

# for sane-toolchain.inc:
LIBC ?= "glibc"
PREFERRED_BINUTILS ?= "${@base_conditional("STM_RELEASE", "stm23", "2.18.50.0.7", "2.17.50.0.5", d)}"
PREFERRED_GCC_VERSION ?= "${@base_conditional("STM_RELEASE", "stm23", "4.2.4", "4.1.1", d)}"
#with one exception for stm22
PREFERRED_VERSION_gcc-cross-intermediate ?= "${@base_conditional("STM_RELEASE", "stm22", "4.2.3", "${PREFERRED_GCC_VERSION}", d)}"
TARGET_VENDOR ?= ""

PREFERRED_VERSION_automake ?= "1.10.2"
PREFERRED_VERSION_automake-native ?= "1.10.2"
#PREFERRED_VERSION_busybox ?= "1.15.3"
PREFERRED_VERSION_libsigc++-1.2 ?= "1.2.5"
PREFERRED_VERSION_linux-libc-headers ?= "${@base_conditional("STM_RELEASE", "stm23", "2.6.23.17", "2.6.17.14", d)}"
#PREFERRED_VERSION_linux-libc-headers ?= "${KV_pn-linux-${MACHINE}}"
PREFERRED_VERSION_swig-native ?= "1.3.39"
PREFERRED_VERSION_wpa-supplicant ?= "0.6.9"
PREFERRED_VERSION_samba = "3.0.37"

PREFERRED_PROVIDER_avahi = "avahi"
PREFERRED_PROVIDER_opkg = "opkg-nogpg"
PREFERRED_PROVIDER_initscripts = "initscripts-opendreambox"
PREFERRED_PROVIDER_virtual/db = "db"
PREFERRED_PROVIDER_virtual/db-native = "db-native"
PREFERRED_PROVIDER_bluez-libs = "bluez-libs"
PREFERRED_PROVIDER_libfribidi = "libfribidi"

# glibc:
PREFERRED_VERSION_glibc = "${@base_conditional("STM_RELEASE", "stm23", "2.6.1", "2.5", d)}"
PREFERRED_VERSION_glibc-initial = "${@base_conditional("STM_RELEASE", "stm23", "2.6.1", "2.5", d)}"

GLIBC_EXTRA_OECONF = "--disable-profile --with-tls --without-fp --with-__thread"

# Change default ipk packaging
IPKGBUILDCMD = "ipkg-build -c -o 0 -g 0"

SRCREV_pn-opkg = "455"

require conf/distro/include/sane-srcdates.inc
require conf/distro/include/sane-srcrevs.inc
require conf/distro/include/sane-toolchain.inc
require conf/distro/include/sane-feed-ipk.inc

SRCDATE_squashfs-tools-native = "20100319"
```

## conf/machine/dm7025.conf
```bitbake
#@TYPE: Machine
#@NAME: Dreambox DM 7025
#@DESCRIPTION: Machine configuration for the Dreambox DM 7025

PREFERRED_VERSION_linux-dm7025 = "2.6.32"
PREFERRED_VERSION_linux-libc-headers = "2.6.32"

EXTRA_IMAGEDEPENDS += "\
	klibc squashfs-tools-native \
	dreambox-boottool \
"

#needed for wpa-supplicant
COMBINED_FEATURES_append = "nl80211"

#JAVA_mipsel = ",java"

#take care when you do changes on MACHINE_ESSENTIAL_EXTRA_RDEPENDS/RRECOMMENDS you have to increment the recipes/tasks/task-boot.bb PR

MACHINE_ESSENTIAL_EXTRA_RDEPENDS = "\
	kernel-module-pata-xilleon \
	kernel-module-nls-iso8859-15 \
	kernel-module-nls-iso8859-1 \
	kernel-module-nls-cp437 \
	kernel-module-nls-cp850 \
	kernel-module-nls-utf8 \
	kernel-module-squashfs \
	kernel-module-unionfs \
	kernel-module-loop \
	dreambox-boottool \
"

MACHINE_ESSENTIAL_EXTRA_RRECOMMENDS = "\
	kernel-module-cifs \
	kernel-module-exportfs \
	kernel-module-ext2 \
	kernel-module-reiserfs \
	kernel-module-xfs \
"

KV = "${PREFERRED_VERSION_linux-dm7025}-1.3-dm7025"

EXTRA_IMAGECMD_jffs2 = " --eraseblock=0x4000 -n -l "
IMAGE_CMD_jffs2 = "\
	install -d ${DEPLOY_DIR_IMAGE}/boot_tmp; \
	for i in bin dev mnt/flash mnt/squashfs mnt/root; \
	do \
		install -d ${IMAGE_ROOTFS}/boot/$i; \
	done; \
	install -d ${IMAGE_ROOTFS}/boot/lib/modules/${KV}/kernel/fs; \
	install -d ${IMAGE_ROOTFS}/boot/lib/modules/${KV}/kernel/drivers/block; \
	install -d ${IMAGE_ROOTFS}/boot/lib/modules/${KV}/kernel/lib; \
	mv ${IMAGE_ROOTFS}/lib/modules/${KV}/kernel/fs/squashfs \
		${IMAGE_ROOTFS}/boot/lib/modules/${KV}/kernel/fs; \
	mv ${IMAGE_ROOTFS}/lib/modules/${KV}/kernel/fs/unionfs \
		${IMAGE_ROOTFS}/boot/lib/modules/${KV}/kernel/fs; \
	mv ${IMAGE_ROOTFS}/lib/modules/${KV}/kernel/drivers/block/loop.ko \
		${IMAGE_ROOTFS}/boot/lib/modules/${KV}/kernel/drivers/block; \
	mv ${IMAGE_ROOTFS}/lib/modules/${KV}/kernel/lib/decompress_unlzma.ko \
		${IMAGE_ROOTFS}/boot/lib/modules/${KV}/kernel/lib; \
	mknod -m 660 ${IMAGE_ROOTFS}/boot/dev/console c 5 1; \
	mknod -m 660 ${IMAGE_ROOTFS}/boot/dev/null c 1 3; \
	mknod -m 660 ${IMAGE_ROOTFS}/boot/dev/mtdblock3 b 31 3; \
	mknod -m 660 ${IMAGE_ROOTFS}/boot/dev/loop0 b 7 0; \
	mkfs.jffs2 \
		--root=${IMAGE_ROOTFS}/boot \
		--faketime \
		--disable-compressor=lzo \
		--compression-mode=size \
		--output=${DEPLOY_DIR_IMAGE}/${IMAGE_NAME}.boot.jffs2 \
		${EXTRA_IMAGECMD}; \
	rm -rf ${DEPLOY_DIR_IMAGE}/boot_tmp; \
	mv ${IMAGE_ROOTFS}/boot ${DEPLOY_DIR_IMAGE}/boot_tmp; \
	install -d ${IMAGE_ROOTFS}/boot; \
	\
	install -d ${DEPLOY_DIR_IMAGE}/${IMAGE_NAME}/delta; \
	cd ${IMAGE_ROOTFS}; \
	for i in `find -maxdepth 3 -name enigma2 | xargs`; \
	do \
		install -d ${DEPLOY_DIR_IMAGE}/${IMAGE_NAME}/delta/${i%%/enigma2}; \
		mv $i ${DEPLOY_DIR_IMAGE}/${IMAGE_NAME}/delta/${i%%/enigma2}; \
	done; \
	for i in `find -type d -name extra | xargs`; \
	do \
		install -d ${DEPLOY_DIR_IMAGE}/${IMAGE_NAME}/delta/${i%%/extra}; \
		mv $i ${DEPLOY_DIR_IMAGE}/${IMAGE_NAME}/delta/${i%%/extra}; \
	done; \
	mv usr/bin/gst* ${DEPLOY_DIR_IMAGE}/${IMAGE_NAME}/delta/usr/bin; \
	mv usr/lib/*gst* ${DEPLOY_DIR_IMAGE}/${IMAGE_NAME}/delta/usr/lib; \
	sed -i 's/^\/dev\/mtdblock2/\/dev\/root/;' ${IMAGE_ROOTFS}/etc/fstab; \
	mksquashfs ${IMAGE_ROOTFS}/* ${DEPLOY_DIR_IMAGE}/${IMAGE_NAME}/squashfs \
		-comp lzma -root-owned -noappend; \
	\
	mkfs.jffs2 \
		--root=${DEPLOY_DIR_IMAGE}/${IMAGE_NAME} \
		--faketime \
		--compression-mode=size \
		--output=${DEPLOY_DIR_IMAGE}/${IMAGE_NAME}.rootfs.jffs2 \
		${EXTRA_IMAGECMD}; \
	for i in ${DEPLOY_DIR_IMAGE}/${IMAGE_NAME}/delta/*; \ 
		do cp -R $i ${IMAGE_ROOTFS}; done; \
	rm -rf ${DEPLOY_DIR_IMAGE}/${IMAGE_NAME}; \
	rm -rf ${IMAGE_ROOTFS}/boot; \
	mv ${DEPLOY_DIR_IMAGE}/boot_tmp ${IMAGE_ROOTFS}/boot; \
	buildimage ${STAGING_LIBDIR}/dreambox-secondstage/main.bin.gz \
		${DEPLOY_DIR_IMAGE}/${IMAGE_NAME}.boot.jffs2 \
		${DEPLOY_DIR_IMAGE}/${IMAGE_NAME}.rootfs.jffs2 \
		${MACHINE} \
		> ${DEPLOY_DIR_IMAGE}/${IMAGE_NAME}.nfi"

MACHINE_FEATURES += "wifi"

require conf/machine/include/dreambox-mipsel.inc
```

## conf/machine/include/cuberevo-sh4.inc
```bitbake
# cuberevo-sh4.inc

MACHINE_FEATURES += "alsa pci wifi"

#PREFERRED_VERSION_linux-libc-headers = "2.6.23.17"
PREFERRED_PROVIDER_task-opendreambox-dvbapi = "task-opendreambox-dvbapi3"
PREFERRED_PROVIDER_task-opendreambox-ui = "task-opendreambox-enigma2"

TARGET_ARCH = "sh4"
#TARGET_FPU = "soft"
PACKAGE_ARCH = ${TARGET_ARCH}
MACHINE_ARCH = "sh4"

require conf/machine/include/cuberevo.inc
```

## conf/machine/include/cuberevo.inc
```bitbake
# cuberevo.inc

EXTRA_IMAGEDEPENDS += "dreambox-secondstage dreambox-buildimage-native"

GLIBC_ADDONS ?= "ports,nptl,libidn"

MACHINE_ESSENTIAL_EXTRA_RDEPENDS += "dreambox-dvb-modules"
MACHINE_FEATURES += "kernel26 usbhost"
DISTRO_FEATURES ?= ""

OLDEST_KERNEL = "2.6.17"

PREFERRED_PROVIDER_virtual/kernel = "linux-${MACHINE}"
```
